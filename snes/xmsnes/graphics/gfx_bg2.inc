; Created with eKid's pcx2snes converter ;

gfx_bg2:
    .db $FF, $00, $FF, $00, $FF, $00, $FF, $00, $FF, $00, $00, $FF, $00, $FF, $00, $FF, $00, $00, $00, $00, $00, $00, $00, $00, $00, $00, $00, $00, $00, $00, $00, $00
    .db $00, $FF, $00, $FF, $00, $FF, $FF, $00, $FF, $00, $FF, $00, $FF, $00, $FF, $00, $00, $00, $00, $00, $00, $00, $00, $00, $00, $00, $00, $00, $00, $00, $00, $00
    .db $00, $FF, $00, $FF, $00, $FF, $00, $FF, $00, $FF, $00, $FF, $00, $FF, $00, $FF, $00, $00, $00, $00, $00, $00, $00, $00, $00, $00, $00, $00, $00, $00, $00, $00

gfxp_bg2:
    .db $5E, $02, $DF, $7F, $91, $6E, $CE, $01, $09, $00, $17, $00, $03, $00, $00, $00
    .db $0F, $34, $16, $6C, $1C, $68, $0E, $38, $32, $03, $A8, $03, $43, $00, $00, $00

; 3 tiles (0 spaces)
; 96 bytes
