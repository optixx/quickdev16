; Created with eKid's pcx2snes converter ;

gfx_window:
    .db $80, $FF, $00, $FF, $3F, $C0, $3F, $C0, $3F, $C0, $3F, $C0, $3F, $C0, $3F, $C0, $00, $00, $00, $00, $00, $00, $00, $00, $00, $00, $00, $00, $00, $00, $00, $00
    .db $00, $FF, $00, $FF, $FF, $00, $FF, $00, $FF, $00, $FF, $00, $FF, $00, $FF, $00, $00, $00, $00, $00, $00, $00, $00, $00, $00, $00, $00, $00, $00, $00, $00, $00
    .db $01, $FF, $03, $FC, $FF, $00, $FF, $00, $FF, $00, $FF, $00, $FF, $00, $FF, $00, $00, $00, $01, $00, $03, $00, $03, $00, $03, $00, $03, $00, $03, $00, $03, $00
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    .db $FF, $00, $FF, $00, $FF, $00, $FF, $00, $FF, $00, $FF, $00, $FF, $00, $FF, $00, $00, $00, $00, $00, $00, $00, $00, $00, $00, $00, $00, $00, $00, $00, $00, $00

gfxp_window:
    .db $1C, $00, $8C, $31, $83, $0C, $EF, $3D, $07, $08, $73, $4E, $03, $50, $00, $00
    .db $0F, $10, $16, $70, $1C, $0C, $0E, $00, $36, $03, $A0, $03, $43, $00, $00, $00

; 9 tiles (0 spaces)
; 288 bytes
