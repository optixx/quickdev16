; Created with eKid's pcx2snes converter ;

gfx_bub:
    .db $00, $00, $00, $00, $00, $00, $00, $00, $00, $00, $00, $00, $00, $00, $00, $00, $00, $00, $00, $00, $00, $00, $00, $00, $00, $00, $00, $00, $00, $00, $00, $00
    .db $00, $00, $00, $00, $00, $00, $00, $00, $00, $00, $00, $00, $00, $00, $00, $00, $00, $00, $00, $00, $00, $00, $00, $00, $00, $00, $00, $00, $00, $00, $00, $00
    .db $00, $00, $00, $00, $00, $00, $00, $00, $00, $00, $00, $00, $00, $00, $00, $00, $00, $00, $00, $00, $00, $00, $00, $00, $00, $00, $00, $00, $00, $00, $00, $00
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    .db $00, $00, $00, $00, $00, $00, $00, $00, $00, $00, $00, $00, $00, $00, $00, $00, $00, $00, $00, $00, $00, $00, $00, $00, $00, $00, $00, $00, $00, $00, $00, $00

gfxp_bub:
    .db $1F, $7C, $61, $1F, $B5, $5A, $01, $3B, $D1, $4B, $07, $1D, $1B, $03, $59, $29
    .db $B7, $63, $C1, $07, $39, $67, $BE, $77, $BC, $35, $7D, $0B, $43, $00, $00, $00

; 128 tiles (0 spaces)
; 4096 bytes
