; Created with eKid's pcx2snes converter ;

gfx_window:
    .db $7F, $00, $FF, $00, $C0, $3F, $C0, $3F, $C0, $3F, $C0, $3F, $C0, $3F, $C0, $3F, $00, $00, $00, $00, $00, $00, $00, $00, $00, $00, $00, $00, $00, $00, $00, $00
    .db $FF, $00, $FF, $00, $00, $FF, $00, $FF, $00, $FF, $00, $FF, $00, $FF, $00, $FF, $00, $00, $00, $00, $00, $00, $00, $00, $00, $00, $00, $00, $00, $00, $00, $00
    .db $FE, $00, $FD, $03, $03, $FF, $03, $FF, $03, $FF, $03, $FF, $03, $FF, $03, $FF, $00, $00, $00, $00, $00, $00, $00, $00, $00, $00, $00, $00, $00, $00, $00, $00
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    .db $00, $FF, $00, $FF, $00, $FF, $00, $FF, $00, $FF, $00, $FF, $00, $FF, $00, $FF, $00, $00, $00, $00, $00, $00, $00, $00, $00, $00, $00, $00, $00, $00, $00, $00

gfxp_window:
    .db $1D, $7C, $60, $18, $46, $49, $0B, $6E, $16, $04, $0D, $00, $03, $50, $00, $00
    .db $0F, $60, $16, $5C, $1C, $0C, $0E, $00, $33, $03, $B9, $03, $43, $00, $00, $00

; 9 tiles (0 spaces)
; 288 bytes
